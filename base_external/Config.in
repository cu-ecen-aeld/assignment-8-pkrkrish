## base_external/Config.in
```kconfig
source "/home/pk/assignment-8-pkrkrish/base_external/package/aesd-assignments/Config.in"
source "/home/pk/assignment-8-pkrkrish/base_external/package/ldd/Config.in"
```
